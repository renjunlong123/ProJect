#include "Ymodem.h"


void array_inversion(flash_parm* f_parm)
{
	if(f_parm->length <= 256)
	{
		for(uint16_t i=0;i < f_parm->length;i++)
		{
			f_parm->w_data[i]=f_parm->r_data_byte[i*4]+(f_parm->r_data_byte[i*4+1]<<8)
			+(f_parm->r_data_byte[i*4+2]<<16)+(f_parm->r_data_byte[i*4+3]<<24);
		}
	}
}
/**
 @brief CRC字节值表高位
 */
const unsigned char crcTableHigh[] =
{
    0x00, 0xC1, 0x81, 0x40, 0x01, 0xC0, 0x80, 0x41, 0x01, 0xC0,
    0x80, 0x41, 0x00, 0xC1, 0x81, 0x40, 0x01, 0xC0, 0x80, 0x41,
    0x00, 0xC1, 0x81, 0x40, 0x00, 0xC1, 0x81, 0x40, 0x01, 0xC0,
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    0x80, 0x41, 0x00, 0xC1, 0x81, 0x40
};

/**
 @brief CRC字节值表低位
 */
const unsigned char crcTableLow[] =
{
    0x00, 0xC0, 0xC1, 0x01, 0xC3, 0x03, 0x02, 0xC2, 0xC6, 0x06,
    0x07, 0xC7, 0x05, 0xC5, 0xC4, 0x04, 0xCC, 0x0C, 0x0D, 0xCD,
    0x0F, 0xCF, 0xCE, 0x0E, 0x0A, 0xCA, 0xCB, 0x0B, 0xC9, 0x09,
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    0x43, 0x83, 0x41, 0x81, 0x80, 0x40
};


/**
 @brief Ymodem CRC 校检
 *只校验数据块的数据，帧头和包序列号不做校验
 */
static uint16_t CRC_Ymodem(const uint8_t* buf,uint8_t len)
{
	uint16_t crc = 0x00;
	uint16_t polynomial = 0x1021;
	uint16_t index,i;
	uint8_t b;
	uint16_t bit;
	uint16_t c15;
	for(index = 0;index<len;index++)
	{
		b = buf[index];
		for(i = 0; i < 8; i++)
		{
			bit = (((b>>(7-i))&1) == 1);
			c15 = (((crc>>15)&1) == 1);
			crc <<= 1;
			if(c15 ^ bit)
			{
				crc ^= polynomial;
			}
		}
	}
	crc &= 0xffff;
	return crc;
}

/**************************************************************/
void Ymodem_Send_C(uint8_t* Ymodem_tx_buf)
{
	Ymodem_tx_buf[0]=YMODEM_C;
	HAL_UART_Transmit(&huart1,Ymodem_tx_buf,YMODEM_TX_BUF_LEN,100);
}

void Ymodem_Send_ACK(uint8_t* Ymodem_tx_buf)
{
	Ymodem_tx_buf[0]=YMODEM_ACK;
	HAL_UART_Transmit(&huart1,Ymodem_tx_buf,YMODEM_TX_BUF_LEN,100);
}

void Ymodem_Send_NAK(uint8_t* Ymodem_tx_buf)
{
	Ymodem_tx_buf[0]=YMODEM_NAK;
	HAL_UART_Transmit(&huart1,Ymodem_tx_buf,YMODEM_TX_BUF_LEN,100);
}

/**
 @brief 打开Ymodem传输
 */
void Open_Ymodem_File_Transfer(const uint8_t* Ymodem_tx_buf)
{
	HAL_UART_Transmit(&huart1,Ymodem_tx_buf,YMODEM_TX_BUF_LEN,100);
	HAL_Delay(500);
}

uint8_t Receive_Start_Frame_Flag;
uint8_t Receive_Data_Frame_Flag;
uint8_t Data_Package_Flag=1;
/**
 @brief Ymodem数据帧
 */

uint8_t Ymodem_Process_Data(const uint8_t* Ymodem_rx_buf)
{
	static uint8_t data_package_FH;
	static uint8_t data_package_FE;
	if(Data_Package_Flag==1)
	{
		Data_Package_Flag=0;
		data_package_FH=0x00;
		data_package_FE=0xFF;
	}
	static uint8_t offset_cnt=0;
	uint8_t app_data_package[YMODEM_DATA_PACKAGE_LEN]={0};
#define APP_DATA_PACKAGE_INIT	memset(app_data_package,0,YMODEM_DATA_PACKAGE_LEN)
	uint16_t offset=YMODEM_DATA_PACKAGE_LEN;
	uint16_t crc_val=0;
	
	if(Receive_Start_Frame_Flag == YMODEM_RECEIVE_START_FRAME_NO_FINISH && Receive_Data_Frame_Flag == YMODEM_RECEIVE_DATA_FRAME_FINISH)
	{
		if(Ymodem_rx_buf[0] == YMODEM_SOH && Ymodem_rx_buf[1] == data_package_FH && Ymodem_rx_buf[2] == data_package_FE)
		{
			for(uint8_t i=0 ; i< YMODEM_DATA_PACKAGE_LEN ; i++)
			{
				app_data_package[i]=Ymodem_rx_buf[i+3];
			}
			crc_val=CRC_Ymodem(app_data_package,YMODEM_DATA_PACKAGE_LEN);
			if(crc_val == ((Ymodem_rx_buf[131]<<8) | (Ymodem_rx_buf[132])) )
			{
				flash_sector_erase((STM32_PAGE_NUM - STM32_B_PAGE_NUM),STM32_A_PAGE_ADDR);
				jump_to_flag=0;
#define W25QXX_SAVE_PATH   0
#if W25QXX_SAVE_PATH == 1
				w25qxx_blockerase(W25Qxx_Write_BLOCK_2_Addr);
#endif				
			}
			else
			{
				return YMODEM_NAK;
			}			
		}
		else
		{
			return YMODEM_NAK;
		}	
	}
	if(Receive_Start_Frame_Flag == YMODEM_RECEIVE_START_FRAME_FINISH && Receive_Data_Frame_Flag == YMODEM_RECEIVE_DATA_FRAME_NO_FINISH)
	{
		if(Ymodem_rx_buf[0] == YMODEM_SOH && Ymodem_rx_buf[1] == data_package_FH && Ymodem_rx_buf[2] == data_package_FE)
		{
			for(uint8_t i=0 ; i< YMODEM_DATA_PACKAGE_LEN ; i++)
			{
				flash_parm_info.r_data_byte[i]=Ymodem_rx_buf[i+3];
			}
			crc_val=CRC_Ymodem(flash_parm_info.r_data_byte,YMODEM_DATA_PACKAGE_LEN);
			if(crc_val == ((Ymodem_rx_buf[131]<<8) | (Ymodem_rx_buf[132])))
			{			
#define SAVE_PATH          1			
#if SAVE_PATH == W25QXX_SAVE_PATH
				if(uint8_t i=0 ; i< YMODEM_DATA_PACKAGE_LEN ; i++)
				{
					w25qxx_PageProgram(W25Qxx_Write_BLOCK_2_Addr+(offset_cnt * offset) , flash_parm_info.r_data_byte ,Y MODEM_DATA_PACKAGE_LEN);
				}	
#else		
				for(uint8_t i=0 ; i< YMODEM_DATA_PACKAGE_LEN_WORD ; i++)
				{
					flash_parm_info.w_data[i]=(flash_parm_info.r_data_byte[i*4]<<0)+(flash_parm_info.r_data_byte[i*4+1]<<8)
					+(flash_parm_info.r_data_byte[i*4+2]<<16)+(flash_parm_info.r_data_byte[i*4+3]<<24);
				}				
				flash_parm_info.address=STM32_A_PAGE_ADDR + offset_cnt*offset;
				flash_parm_info.length=YMODEM_DATA_PACKAGE_LEN_WORD;
				update_To_flash(&flash_parm_info,STM32_A_PAGE_NUM,STM32_FLASH_END_ADDR);
#endif
				offset_cnt++;		
			}
			else
			{
				return YMODEM_NAK;
			}
			
/*#define READ_W25QXX_DATA_PACKAGE_LOG*/				
#ifdef READ_W25QXX_DATA_PACKAGE_LOG			
#if SAVE_PATH==W25QXX_SAVE_PATH
			uint8_t buf[YMODEM_DATA_PACKAGE_LEN]={0};
			w25qxx_ReadData(W25Qxx_Write_BLOCK_2_Addr+(w25qxx_addr_offset_cnt * i),buf,YMODEM_DATA_PACKAGE_LEN);
			HAL_UART_Transmit(&huart1,buf,YMODEM_DATA_PACKAGE_LEN,100);
#else
			stm_flash_read(&flash_parm_info,FLASH_READ_BYTE);
			HAL_UART_Transmit(&huart1,flash_parm_info.r_data_byte,(flash_parm_info.length*4),100);
#endif			
#endif		
		}
		else
		{
			return YMODEM_NAK;
		}
	}
	data_package_FH++;
	data_package_FE--;
	return YMODEM_ACK;
}

/**
 @brief Ymodem结束帧
 */
void Ymodem_End_Frame(uint8_t* Ymodem_tx_buf)
{
	Ymodem_Send_ACK(Ymodem_tx_buf);
}


