#include "app_data.h"
SerialMsg _SerialMsg2;
/**************************************************************/
/**
 @brief CRC字节值表高位
 */
const unsigned char crcTableHigh[] =
{
    0x00, 0xC1, 0x81, 0x40, 0x01, 0xC0, 0x80, 0x41, 0x01, 0xC0,
    0x80, 0x41, 0x00, 0xC1, 0x81, 0x40, 0x01, 0xC0, 0x80, 0x41,
    0x00, 0xC1, 0x81, 0x40, 0x00, 0xC1, 0x81, 0x40, 0x01, 0xC0,
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    0x80, 0x41, 0x00, 0xC1, 0x81, 0x40
};
/**
 @brief CRC字节值表低位
 */
const unsigned char crcTableLow[] =
{
    0x00, 0xC0, 0xC1, 0x01, 0xC3, 0x03, 0x02, 0xC2, 0xC6, 0x06,
    0x07, 0xC7, 0x05, 0xC5, 0xC4, 0x04, 0xCC, 0x0C, 0x0D, 0xCD,
    0x0F, 0xCF, 0xCE, 0x0E, 0x0A, 0xCA, 0xCB, 0x0B, 0xC9, 0x09,
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    0x43, 0x83, 0x41, 0x81, 0x80, 0x40
};
/*XModem CRC 校检*/
static uint16_t CRC_XModem(const uint8_t* buf,uint8_t len)
{
	uint16_t crc = 0x00;
	uint16_t polynomial = 0x1021;
	uint16_t index,i;
	uint8_t b;
	uint16_t bit;
	uint16_t c15;
	for(index = 0;index<len;index++)
	{
		b = buf[index];
		for(i = 0; i < 8; i++)
		{
			bit = (((b>>(7-i))&1) == 1);
			c15 = (((crc>>15)&1) == 1);
			crc <<= 1;
			if(c15 ^ bit)
			{
				crc ^= polynomial;
			}
		}
	}
	crc &= 0xffff;
	return crc;
}
/******************************************************************************/
/*串口1发送数据*/
void uart1_send_data_loading(void)
{
	uint8_t tx_buf[5]={0x00,0x00,0x7E,0x40,0x6A};
	rt_device_write(Dev_InitStruct.dev_serial_1,0,tx_buf,sizeof(tx_buf));
	memset(tx_buf,0,sizeof(tx_buf));
}
/*串口1处理数据*/
uint8_t Proccess_Serial_1_RxData(const uint8_t* Serial_1_RxData)
{
	if(Serial_1_RxData==RT_NULL)
	{
		return Error;
	}
	uint8_t RxInspection_Buf[3]={0};
	RxInspection_Buf[0]=0x7E;
	RxInspection_Buf[1]=0x40;
	RxInspection_Buf[2]=0x00;
	for(uint8_t i=0;i<3;i++)
	{
		if(Serial_1_RxData[i]!=RxInspection_Buf[i])
		{
			return Error;
		}
	}
	uint16_t Serial_1_RXCRC=CRC_XModem(Serial_1_RxData,serial_1_rx_buf_size-2);
	if(Serial_1_RXCRC != ((Serial_1_RxData[serial_1_rx_buf_size-2]) | (Serial_1_RxData[serial_1_rx_buf_size-1]<<8)))
	{
		return Error;
	}
	_BatVal.Bat_GDZT=Serial_1_RxData[3];
	_BatVal.Bat_DL=Serial_1_RxData[4];
	_BatVal.Bat_TEMP=(Serial_1_RxData[6]<<8) + Serial_1_RxData[7];
	if(_BatVal.Bat_GDZT==1)
	{
		_BatVal.Bat_FD_DL=(Serial_1_RxData[10]<<8) + Serial_1_RxData[11];
		_BatVal.Bat_CD_DL=0x00;
	}
	else
	{
		_BatVal.Bat_FD_DL=0x00;
		_BatVal.Bat_CD_DL=(Serial_1_RxData[8]<<8) + Serial_1_RxData[9];
	}
	_BatVal.Bat_voltage=Serial_1_RxData[12];
	return True;
}
/*串口2处理数据 485*/
static void DY_KZ_STU(uint8_t val);
static void FZKZ_KZ(uint8_t KZ,uint8_t val);
uint8_t Proccess_Serial_2_RxData(const uint8_t* Serial_2_RxData)
{
	if(Serial_2_RxData==RT_NULL)
	{
		return Error;
	}
	_SerialMsg2.Serial_2_RxInspection[0]=0x00;
	_SerialMsg2.Serial_2_RxInspection[1]=0x00;
	_SerialMsg2.Serial_2_RxInspection[2]=0x7E;
	_SerialMsg2.Serial_2_RxInspection[3]=0x40;
	_SerialMsg2.Serial_2_RxInspection[4]=0x6A;
//	_SerialMsg2.Serial_2_RxInspection[5]=0x00;
//	_SerialMsg2.Serial_2_RxInspection[6]=0x00;
	uint8_t i=0;
	for(i=0;i<sizeof(_SerialMsg2.Serial_2_RxInspection);i++)
	{
		if(_SerialMsg2.Serial_2_RxInspection[i]!=Serial_2_RxData[i])
		{
			return Error;
		}
	}
	_SerialMsg2.Serial_2_RXCRC=CRC_XModem(Serial_2_RxData,8);
	if(_SerialMsg2.Serial_2_RXCRC != ((Serial_2_RxData[8]) | (Serial_2_RxData[9]<<8)))
	{
		return Error;
	}
	FZKZ_KZ(1,Serial_2_RxData[5]);
	FZKZ_KZ(2,Serial_2_RxData[6]);
	DY_KZ_STU(Serial_2_RxData[7]);
	return True;
}
/*串口2发送数据*/
uint8_t Serial_2_485_Send_Data(uint8_t* Serial_2_TxData)
{
	Serial_2_TxData[0]=0x7E;
	Serial_2_TxData[1]=0x40;
	Serial_2_TxData[2]=0x00;
	/*供电状态*/
	Serial_2_TxData[3]=_BatVal.Bat_GDZT;
	/*电量*/
	Serial_2_TxData[4]=_BatVal.Bat_DL;
	/*固定码*/
	Serial_2_TxData[5]=0x01;
	/*电池温度*/
	uint16_t temp=_BatVal.Bat_TEMP*10;
	Serial_2_TxData[6]=temp>>8;
	Serial_2_TxData[7]=temp;
//	Serial_2_TxData[6]=_BatVal.Bat_TEMP>>8;
//	Serial_2_TxData[7]=_BatVal.Bat_TEMP;
	if(_BatVal.Bat_GDZT==BAT_GDZT_DC)
	{
		/*放电电流高前低后*/
		Serial_2_TxData[8]=0;
		Serial_2_TxData[9]=0;
		Serial_2_TxData[10]=_BatVal.Bat_FD_DL>>8;
		Serial_2_TxData[11]=_BatVal.Bat_FD_DL;
	}
	else
	{
		/*充电电流高前低后*/
		Serial_2_TxData[8]=_BatVal.Bat_CD_DL>>8;
		Serial_2_TxData[9]=_BatVal.Bat_CD_DL;
		Serial_2_TxData[10]=0;
		Serial_2_TxData[11]=0;
	}
	/*电池电压*/
	Serial_2_TxData[12]=_BatVal.Bat_voltage*10;
	/*固定码*/
	Serial_2_TxData[13]=0x0C;
	Serial_2_TxData[14]=0x0C;
	Serial_2_TxData[15]=0x0C;
	Serial_2_TxData[16]=0x0C;
	Serial_2_TxData[17]=0x0C;
	/*校验码*/
	_SerialMsg2.Serial_2_TXCRC=CRC_XModem(Serial_2_TxData,serial_2_tx_buf_size-2);
	Serial_2_TxData[18]=_SerialMsg2.Serial_2_TXCRC;
	Serial_2_TxData[19]=_SerialMsg2.Serial_2_TXCRC>>8;
	return serial_2_tx_buf_size;
}
/******************************************************************************/
void DY_KZ_STU(uint8_t val)
{
	switch(val)
	{
		case DYKZ_AC:
			_IO_AC_LED_L;
			break;
		case DYKZ_BAT:
			_IO_AC_LED_H;
			break;
	}
}
static void FZKZ_KZ(uint8_t KZ,uint8_t val)
{
	if(KZ==1){
		if(val){
			_IO_KZ_1_H;
		}
		else{
			_IO_KZ_1_L;
		}
	}
	else{
		if(val){
			_IO_KZ_2_H;
		}
		else{
			_IO_KZ_2_L;
		}
	}
}